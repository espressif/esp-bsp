## components/lcd_touch/esp_lcd_touch_cst816s/Kconfig
```kconfig
menu "ESP LCD TOUCH - CST816S"

    config ESP_LCD_TOUCH_CST816S_DISABLE_READ_ID
        bool "Disable reading ID during initialization"
        default n
        help
            For some CST816 series chips, reading ID may cause initialization failure.

endmenu
```

## components/mpu60xx/Kconfig
```kconfig
menu "MPU60xx : CONFIGURATION"

    config MPU60xx_I2C_CLK_SPEED
        int "I2C clock speed"
		default 300000
	range 1 400000
        help
            Clock speed used for i2c communication by MPU60xx device.
	    Limited to maximum of 400KHZ.
		    
endmenu
```

## components/pedrominatel__shtc3/Kconfig
```kconfig
menu "Driver SHTC3 Sensor"
            
    menu "I2C"
        config SHTC3_I2C_NUM
            int "I2C peripheral index"
            default -1
            range -1 3
            help
                For auto select I2C peripheral, set to -1.

        config SHTC3_I2C_SDA
            int "I2C SDA pin"
            default 17
            range 0 55
            help
                Set the I2C SDA pin for the data signal.

        config SHTC3_I2C_SCL
            int "I2C SCL pin"
            default 18
            range 0 55
            help
                Set the I2C SCL pin for the clock signal.

        config SHTC3_I2C_CLK_SPEED_HZ
            int "I2C clock speed (Hz)"
            default 100000
            range 10000 400000
            help
                Set the I2C clock speed in Hz.
    endmenu
  
endmenu
```

## components/sensors/bmi270/test_app/sdkconfig.defaults
```kconfig
CONFIG_IDF_TARGET="esp32p4"
CONFIG_COMPILER_OPTIMIZATION_PERF=y

CONFIG_FREERTOS_HZ=1000
CONFIG_FREERTOS_TIMER_TASK_STACK_DEPTH=4096

CONFIG_ESPTOOLPY_FLASHSIZE_4MB=y
CONFIG_CODEC_I2C_BACKWARD_COMPATIBLE=n

# SPIRAM for ESP32-P4
CONFIG_SPIRAM=y
CONFIG_SPIRAM_SPEED_200M=y
CONFIG_IDF_EXPERIMENTAL_FEATURES=y
```

## esp-box/Kconfig
```kconfig
menu "Board Support Package"
    config BSP_I2C_NUM
        int "I2C peripheral index"
        default 1
        range 0 1
        help
            ESP32S3 has two I2C peripherals, pick the one you want to use.

    config BSP_I2C_FAST_MODE
        bool "Enable I2C fast mode"
        default y
        help
            I2C has two speed modes: normal (100kHz) and fast (400kHz).

    config BSP_I2C_CLK_SPEED_HZ
        int
        default 400000 if BSP_I2C_FAST_MODE
        default 100000

    config BSP_I2S_NUM
        int "I2S peripheral index"
        default 1
        range 0 1
        help
            ESP32S3 has two I2S peripherals, pick the one you want to use.

    menu "Display"
        config BSP_DISPLAY_LVGL_TASK_PRIORITY
            int "LVGL task priority"
            default 2
            help
                The Board Support Package will create a task that will periodically handle LVGL operation in lv_timer_handler().

        config BSP_DISPLAY_BRIGHTNESS_LEDC_CH
        int "LEDC channel index"
        default 1
        range 0 7
        help
            LEDC channel is used to generate PWM signal that controls display brightness.
            Set LEDC index that should be used.

        config BSP_DISPLAY_LVGL_TICK
        int "LVGL tick period"
        default 5
        range 1 100
        help
            Period of LVGL tick timer.

    endmenu
endmenu
```

## esp32_azure_iot_kit/Kconfig
```kconfig
menu "Board Support Package"
    menu "I2C"
        config BSP_I2C_NUM
            int "I2C peripheral index"
            default 1
            range 0 1
            help
                ESP32 has two I2C peripherals, pick the one you want to use.

        config BSP_I2C_FAST_MODE
            bool "Enable I2C fast mode"
            default n
            help
                I2C has two speed modes: normal (100kHz) and fast (400kHz).

        config BSP_I2C_CLK_SPEED_HZ
            int
            default 400000 if BSP_I2C_FAST_MODE
            default 100000

    endmenu

    menu "uSD card - Virtual File System"
        config BSP_uSD_FORMAT_ON_MOUNT_FAIL
            bool "Format uSD card if mounting fails"
            default n
            help
                The SDMMC host will format (FAT) the uSD card if it fails to mount the filesystem.

        config BSP_uSD_MOUNT_POINT
            string "uSD card mount point"
            default "/sdcard"
            help
                Mount point of the uSD card in the Virtual File System

    endmenu

    menu "Buzzer"
        config BSP_BUZZER_FREQUENCY
            int "Buzzer frequency [Hz]"
            default 4000
            range 1000 8000
            help
                Resonant requency of onboard buzzer is 4kHz.

        config BSP_BUZZER_LEDC_TIMER_NUM
            int "LEDC timer number for buzzer"
            default 0
            range 0 3
            help
                LEDC peripheral has 4 timers, pick one.

        config BSP_BUZZER_LEDC_CHANNEL_NUM
            int "LEDC channel number for buzzer"
            default 0
            range 0 7
            help
                LEDC peripheral has 7 high-speed channels, pick one.

    endmenu
endmenu
```

## esp32_s2_kaluga_kit/Kconfig
```kconfig
menu "Board Support Package"

    config BSP_ERROR_CHECK
        bool "Enable error check in BSP"
        default y
        help
            Error check assert the application before returning the error code.

    menu "I2C"
        config BSP_I2C_NUM
            int "I2C peripheral index"
            default 1
            range 0 1
            help
                ESP32-S2 has two I2C peripherals, pick the one you want to use.

        config BSP_I2C_FAST_MODE
            bool "Enable I2C fast mode"
            default y
            help
                I2C has two speed modes: normal (100kHz) and fast (400kHz).

        config BSP_I2C_CLK_SPEED_HZ
            int
            default 400000 if BSP_I2C_FAST_MODE
            default 100000
    endmenu
endmenu
```

## esp32_s2_kaluga_kit/examples/display_audio/sdkconfig.defaults
```kconfig
CONFIG_IDF_TARGET="esp32s2"

#
# Serial flasher config
#
CONFIG_ESPTOOLPY_FLASHSIZE_4MB=y
# end of Serial flasher config

CONFIG_ESP32S2_SPIRAM_SUPPORT=y
CONFIG_SPIFFS_PAGE_SIZE=1024

#
# Partition Table
#
# CONFIG_PARTITION_TABLE_SINGLE_APP is not set
# CONFIG_PARTITION_TABLE_TWO_OTA is not set
CONFIG_PARTITION_TABLE_CUSTOM=y
CONFIG_PARTITION_TABLE_CUSTOM_FILENAME="partitions.csv"
CONFIG_PARTITION_TABLE_FILENAME="partitions.csv"
CONFIG_PARTITION_TABLE_OFFSET=0x8000
CONFIG_PARTITION_TABLE_MD5=y
# end of Partition Table

#
# LVGL configuration
#
CONFIG_LV_HOR_RES_MAX=320
CONFIG_LV_VER_RES_MAX=240
CONFIG_LV_COLOR_16_SWAP=y
CONFIG_LV_USE_PERF_MONITOR=y
# end of LVGL configuration

#
# LVGL TFT Display controller
#
CONFIG_LV_TFT_DISPLAY_USER_CONTROLLER_ST7789=y
CONFIG_DISPLAY_ORIENTATION_PORTRAIT_INVERTED=y
CONFIG_LV_DISP_BACKLIGHT_OFF=y

#
# Display Pin Assignments
#
CONFIG_LV_DISP_SPI_MOSI=9
CONFIG_LV_DISP_SPI_CLK=15
CONFIG_LV_DISPLAY_USE_SPI_CS=y
CONFIG_LV_DISP_SPI_CS=11
CONFIG_LV_DISPLAY_USE_DC=y
CONFIG_LV_DISP_PIN_DC=13
CONFIG_LV_DISP_PIN_RST=16
# end of Display Pin Assignments
# end of LVGL TFT Display controller
```

## esp32_s2_kaluga_kit/sdkconfig.defaults
```kconfig
#
# Serial flasher config
#
CONFIG_ESPTOOLPY_FLASHSIZE_4MB=y
# end of Serial flasher config

#
# LVGL configuration
#
CONFIG_LV_HOR_RES_MAX=320
CONFIG_LV_VER_RES_MAX=240
CONFIG_LV_COLOR_16_SWAP=y
# end of LVGL configuration

#
# LVGL TFT Display controller
#
CONFIG_LV_TFT_DISPLAY_USER_CONTROLLER_ST7789=y
CONFIG_DISPLAY_ORIENTATION_PORTRAIT_INVERTED=y

#
# Display Pin Assignments
#
CONFIG_LV_DISP_SPI_MOSI=9
CONFIG_LV_DISP_SPI_CLK=15
CONFIG_LV_DISPLAY_USE_SPI_CS=y
CONFIG_LV_DISP_SPI_CS=11
CONFIG_LV_DISPLAY_USE_DC=y
CONFIG_LV_DISP_PIN_DC=13
CONFIG_LV_DISP_PIN_RST=16
# end of Display Pin Assignments
# end of LVGL TFT Display controller
```

## esp32_s3_eye/Kconfig
```kconfig
menu "Board Support Package"

    config BSP_ERROR_CHECK
        bool "Enable error check in BSP"
        default y
        help
            Error check assert the application before returning the error code.
            
    menu "I2C"
        config BSP_I2C_NUM
            int "I2C peripheral index"
            default 1
            range 0 1
            help
                ESP32-S2 has two I2C peripherals, pick the one you want to use.

        config BSP_I2C_FAST_MODE
            bool "Enable I2C fast mode"
            default y
            help
                I2C has two speed modes: normal (100kHz) and fast (400kHz).

        config BSP_I2C_CLK_SPEED_HZ
            int
            default 400000 if BSP_I2C_FAST_MODE
            default 100000
    endmenu
    menu "uSD card - Virtual File System"
        config BSP_SD_FORMAT_ON_MOUNT_FAIL
            bool "Format uSD card if mounting fails"
            default n
            help
                The SDMMC host will format (FAT) the uSD card if it fails to mount the filesystem.

        config BSP_SD_MOUNT_POINT
            string "uSD card mount point"
            default "/sdcard"
            help
                Mount point of the uSD card in the Virtual File System

    endmenu
    menu "Display"
        config BSP_DISPLAY_LVGL_TASK_PRIORITY
            int "LVGL task priority"
            default 2
            help
                The Board Support Package will create a task that will periodically handle LVGL operation in lv_timer_handler().

        config BSP_DISPLAY_LVGL_TICK
            int "LVGL tick period"
            default 5
            range 1 100
            help
                Period of LVGL tick timer.

        config BSP_DISPLAY_BRIGHTNESS_LEDC_CH
            int "LEDC channel index"
            default 1
            range 0 7
            help
                LEDC channel is used to generate PWM signal that controls display brightness.
                Set LEDC index that should be used.
    endmenu
endmenu
```

## esp32_s3_lcd_ev_board/Kconfig
```kconfig
menu "Board Support Package"

    config BSP_ERROR_CHECK
        bool "Enable error check in BSP"
        default y
        help
            Error check assert the application before returning the error code.

    menu "I2C"
        config BSP_I2C_NUM
            int "I2C peripheral index"
            default 1
            range 0 1
            help
                ESP32S3 has two I2C peripherals, pick the one you want to use.

        config BSP_I2C_FAST_MODE
            bool "Enable I2C fast mode"
            default y
            help
                I2C has two speed modes: normal (100kHz) and fast (400kHz).

        config BSP_I2C_CLK_SPEED_HZ
            int
            default 400000 if BSP_I2C_FAST_MODE
            default 100000
    endmenu

    menu "LCD"
        choice BSP_LCD_SUB_BOARD
            prompt "Select Sub board"
            default BSP_LCD_SUB_BOARD_800_480
            config BSP_LCD_SUB_BOARD_480_480
                bool "Sub board 2 with 480x480 RGB LCD"
            config BSP_LCD_SUB_BOARD_800_480
                bool "Sub board 3 with 800x480 RGB LCD"
        endchoice

        config BSP_LCD_RGB_DOUBLE_BUFFER
            bool "Enable to use double frame buffers"
            depends on BSP_LCD_SUB_BOARD_480_480 || BSP_LCD_SUB_BOARD_800_480
            default "n"
            help
                Let RGB LCD driver create two frame size buffers. It's a necessary configuration to avoiding tearing effect.

        config BSP_LCD_RGB_REFRESH_TASK_ENABLE
            bool "Enable to refresh LCD manually"
            depends on BSP_LCD_SUB_BOARD_480_480 || BSP_LCD_SUB_BOARD_800_480
            default "n"
            help
                Refresh the LCD in a specific task instead of automatically refreshing. It's a necessary configuration to avoiding tearing effect.

        config BSP_LCD_RGB_REFRESH_TASK_PERIOD
            int "Minimum Period(ms) of LCD refreshing task"
            depends on BSP_LCD_RGB_REFRESH_TASK_ENABLE
            default 10
            help
               This configuration does not necessarily represent the actual refresh cycle of the RGB interface.

        config BSP_LCD_RGB_REFRESH_TASK_PRIORITY
            int "Priority of LCD refreshing task"
            depends on BSP_LCD_RGB_REFRESH_TASK_ENABLE
            default 2
    endmenu

    menu "Display"
        config BSP_DISPLAY_LVGL_TASK_PRIORITY
            int "LVGL task priority"
            default 2
            help
                The Board Support Package will create a task that will periodically handle LVGL operation in lv_timer_handler().

        config BSP_DISPLAY_LVGL_TICK
            int "LVGL tick period"
            default 5
            range 1 100
            help
                Period of LVGL tick timer.

        config BSP_DISPLAY_LVGL_AVOID_TEAR
            bool "Avoid tearing effect"
            depends on BSP_LCD_RGB_REFRESH_TASK_ENABLE && BSP_LCD_RGB_DOUBLE_BUFFER
            default "n"
            help
                Avoid tearing effect through LVGL buffer mode and double frame buffers of RGB LCD. This feature is only available for RGB LCD.

        choice BSP_DISPLAY_LVGL_MODE
            depends on BSP_DISPLAY_LVGL_AVOID_TEAR
            prompt "Select LVGL buffer mode"
            default BSP_DISPLAY_LVGL_FULL_REFRESH
            config BSP_DISPLAY_LVGL_FULL_REFRESH
                bool "Full refresh"
            config BSP_DISPLAY_LVGL_DIRECT_MODE
                bool "Direct mode"
        endchoice

        choice BSP_DISPLAY_LVGL_BUF_CAPS
            depends on !BSP_DISPLAY_LVGL_AVOID_TEAR
            prompt "Select LVGL buffer memory capability"
            default BSP_DISPLAY_LVGL_INTERNAL
            config BSP_DISPLAY_LVGL_PSRAM
                bool "PSRAM memory"
            config BSP_DISPLAY_LVGL_INTERNAL
                bool "Internal memory"
        endchoice

        config BSP_DISPLAY_LVGL_BUF_HEIGHT
            depends on !BSP_DISPLAY_LVGL_AVOID_TEAR
            int "LVGL buffer height"
            default 100
            help
                Height of LVGL buffer. The width of the buffer is the same as that of the LCD.
    endmenu

    config BSP_I2S_NUM
        int "I2S peripheral index"
        default 1
        range 0 1
        help
            ESP32S3 has two I2S peripherals, pick the one you want to use.
endmenu
```

## esp32_s3_usb_otg/Kconfig
```kconfig
menu "Board Support Package"
    menu "uSD card - Virtual File System"
        config BSP_uSD_FORMAT_ON_MOUNT_FAIL
            bool "Format uSD card if mounting fails"
            default n
            help
                The SDMMC host will format (FAT) the uSD card if it fails to mount the filesystem.

        config BSP_uSD_MOUNT_POINT
            string "uSD card mount point"
            default "/sdcard"
            help
                Mount point of the uSD card in the Virtual File System

    endmenu
    menu "Display"
        config BSP_DISPLAY_LVGL_TASK_PRIORITY
            int "LVGL task priority"
            default 2
            help
                The Board Support Package will create a task that will periodically handle LVGL operation in lv_timer_handler().

        config BSP_DISPLAY_LVGL_TICK
            int "LVGL tick period"
            default 5
            range 1 100
            help
                Period of LVGL tick timer.

        config BSP_DISPLAY_BRIGHTNESS_LEDC_CH
            int "LEDC channel index"
            default 1
            range 0 7
            help
                LEDC channel is used to generate PWM signal that controls display brightness.
                Set LEDC index that should be used.
    endmenu
endmenu
```
