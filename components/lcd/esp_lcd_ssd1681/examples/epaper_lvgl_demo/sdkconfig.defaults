## esp_wrover_kit/Kconfig
```kconfig
menu "Board Support Package"

    config BSP_ERROR_CHECK
        bool "Enable error check in BSP"
        default y
        help
            Error check assert the application before returning the error code.

    menu "uSD card - Virtual File System"
        config BSP_uSD_FORMAT_ON_MOUNT_FAIL
            bool "Format uSD card if mounting fails"
            default n
            help
                The SDMMC host will format (FAT) the uSD card if it fails to mount the filesystem.

        config BSP_uSD_MOUNT_POINT
            string "uSD card mount point"
            default "/sdcard"
            help
                Mount point of the uSD card in the Virtual File System

    endmenu
    menu "Display"
        config BSP_DISPLAY_BRIGHTNESS_LEDC_CH
            int "LEDC channel index"
            default 1
            range 0 7
            help
                LEDC channel is used to generate PWM signal that controls display brightness.
                Set LEDC index that should be used.

        choice
            prompt "LCD type"
            default BSP_LCD_ILI9341
            help
                Wrover-kit is shipped with two different LCD controllers, pick the one you want to use.

            config BSP_LCD_ST7789
                bool "ST7789"
            config BSP_LCD_ILI9341
                bool "ILI9341"
        endchoice
    endmenu
endmenu
```

## esp_wrover_kit/examples/display/sdkconfig.defaults
```kconfig
#
# Serial flasher config
#
CONFIG_ESPTOOLPY_FLASHSIZE_4MB=y
# end of Serial flasher config

#
# LVGL configuration
#
CONFIG_LV_COLOR_16_SWAP=y
# end of LVGL configuration
```
