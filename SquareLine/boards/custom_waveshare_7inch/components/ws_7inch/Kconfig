## components/bsp_selector/Kconfig
```kconfig
menu "BSP Selector"

    # Hidden variables to drive Conditional Dependencies
    
    config ESP_BSP_DEVKIT
        int
        default 1 if BSP_SELECT_ESP_BSP_DEVKIT
        default 0
    
    config ESP_BSP_GENERIC
        int
        default 1 if BSP_SELECT_ESP_BSP_GENERIC
        default 0
    
    config ESP_WROVER_KIT
        int
        default 1 if BSP_SELECT_ESP_WROVER_KIT
        default 0
    
    config ESP32_C3_LCDKIT
        int
        default 1 if BSP_SELECT_ESP32_C3_LCDKIT
        default 0
    
    config ESP32_LYRAT
        int
        default 1 if BSP_SELECT_ESP32_LYRAT
        default 0
    
    config ESP32_P4_EYE
        int
        default 1 if BSP_SELECT_ESP32_P4_EYE
        default 0
    
    config ESP32_P4_FUNCTION_EV_BOARD
        int
        default 1 if BSP_SELECT_ESP32_P4_FUNCTION_EV_BOARD
        default 0
    
    config ESP32_S3_EYE
        int
        default 1 if BSP_SELECT_ESP32_S3_EYE
        default 0
    
    config ESP32_S3_KORVO_1
        int
        default 1 if BSP_SELECT_ESP32_S3_KORVO_1
        default 0
    
    config ESP32_S3_KORVO_2
        int
        default 1 if BSP_SELECT_ESP32_S3_KORVO_2
        default 0
    
    config ESP32_S3_LCD_EV_BOARD
        int
        default 1 if BSP_SELECT_ESP32_S3_LCD_EV_BOARD
        default 0
    
    config ESP32_S3_USB_OTG
        int
        default 1 if BSP_SELECT_ESP32_S3_USB_OTG
        default 0
    
    config ESP_BOX_3
        int
        default 1 if BSP_SELECT_ESP_BOX_3
        default 0
    
    config M5_ATOM_S3
        int
        default 1 if BSP_SELECT_M5_ATOM_S3
        default 0
    
    config M5DIAL
        int
        default 1 if BSP_SELECT_M5DIAL
        default 0
    
    config M5STACK_CORE
        int
        default 1 if BSP_SELECT_M5STACK_CORE
        default 0
    
    config M5STACK_CORE_2
        int
        default 1 if BSP_SELECT_M5STACK_CORE_2
        default 0
    
    config M5STACK_CORE_S3
        int
        default 1 if BSP_SELECT_M5STACK_CORE_S3
        default 0
    
    config M5STACK_TAB5
        int
        default 1 if BSP_SELECT_M5STACK_TAB5
        default 0
        

    choice BSP_SELECT
        prompt "Select BSP"
        default BSP_SELECT_ESP_WROVER_KIT if IDF_TARGET_ESP32
        default BSP_SELECT_ESP32_S2_KALUGA_KIT if IDF_TARGET_ESP32S2
        default BSP_SELECT_ESP_BOX_3 if IDF_TARGET_ESP32S3
        default BSP_SELECT_ESP32_P4_FUNCTION_EV_BOARD if IDF_TARGET_ESP32P4
        default BSP_SELECT_ESP32_C3_LCDKIT if IDF_TARGET_ESP32C3
        help
            Select which BSP will be used in project.
            
        config BSP_SELECT_NONE
            bool "ESP_BSP_NONE"
            
        config BSP_SELECT_ESP_BSP_DEVKIT
            bool "ESP_BSP_DEVKIT"
            
        config BSP_SELECT_ESP_BSP_GENERIC
            bool "ESP_BSP_GENERIC"
        
        config BSP_SELECT_ESP_WROVER_KIT
            depends on IDF_TARGET_ESP32
            bool "ESP_WROVER_KIT"
            
        config BSP_SELECT_ESP32_C3_LCDKIT
            depends on IDF_TARGET_ESP32C3
            bool "ESP32_C3_LCDKIT"
            
        config BSP_SELECT_ESP32_LYRAT
            depends on IDF_TARGET_ESP32
            bool "ESP32_LYRAT"
            
        config BSP_SELECT_ESP32_P4_EYE
            depends on IDF_TARGET_ESP32P4
            bool "ESP32_P4_EYE"
            
        config BSP_SELECT_ESP32_P4_FUNCTION_EV_BOARD
            depends on IDF_TARGET_ESP32P4
            bool "ESP32_P4_FUNCTION_EV_BOARD"
            
        config BSP_SELECT_ESP32_S3_EYE
            depends on IDF_TARGET_ESP32S3
            bool "ESP32_S3_EYE"
            
        config BSP_SELECT_ESP32_S3_KORVO_1
            depends on IDF_TARGET_ESP32S3
            bool "ESP32_S3_KORVO_1"
            
        config BSP_SELECT_ESP32_S3_KORVO_2
            depends on IDF_TARGET_ESP32S3
            bool "ESP32_S3_KORVO_2"
            
        config BSP_SELECT_ESP32_S3_LCD_EV_BOARD
            depends on IDF_TARGET_ESP32S3
            bool "ESP32_S3_LCD_EV_BOARD"
            
        config BSP_SELECT_ESP32_S3_USB_OTG
            depends on IDF_TARGET_ESP32S3
            bool "ESP32_S3_USB_OTG"
            
        config BSP_SELECT_ESP_BOX_3
            depends on IDF_TARGET_ESP32S3
            bool "ESP_BOX_3"
            
        config BSP_SELECT_M5_ATOM_S3
            depends on IDF_TARGET_ESP32S3
            bool "M5_ATOM_S3"
            
        config BSP_SELECT_M5DIAL
            depends on IDF_TARGET_ESP32S3
            bool "M5DIAL"
            
        config BSP_SELECT_M5STACK_CORE
            depends on IDF_TARGET_ESP32
            bool "M5STACK_CORE"
            
        config BSP_SELECT_M5STACK_CORE_2
            depends on IDF_TARGET_ESP32
            bool "M5STACK_CORE_2"
            
        config BSP_SELECT_M5STACK_CORE_S3
            depends on IDF_TARGET_ESP32S3
            bool "M5STACK_CORE_S3"
            
        config BSP_SELECT_M5STACK_TAB5
            depends on IDF_TARGET_ESP32P4
            bool "M5STACK_TAB5"
            
   endchoice     

endmenu
```

## components/ds18b20/Kconfig.projbuild
```kconfig
menu "DS18B20 Configuration"

    config DS18B20_SENSOR_HUB
        bool "Enable sensor hub integration"
        default n
        help
            Add sensor hub component and link the implementation layer.
            NOTE: Only a single DS18B20 device is supported.

endmenu
```

## components/ds18b20/examples/ds18b20_read/main/Kconfig.projbuild
```kconfig
menu "Example Configuration"

    config EXAMPLE_ONEWIRE_BUS_GPIO
        int "1-Wire bus GPIO number"
        range 0 48
        default 0
        help
            GPIO used by the 1-Wire bus.

    config EXAMPLE_ONEWIRE_MAX_DS18B20
        int "Maximum number of DS18B20 devices to enumerate"
        range 1 32
        default 2
        help
            Stop searching after this many DS18B20 devices are found.

    config EXAMPLE_ONEWIRE_ENABLE_INTERNAL_PULLUP
        bool "Enable internal pull-up resistor on bus GPIO"
        default y
        help
            Enable this when there is no external pull-up resistor on the
            1-Wire data line.

    choice EXAMPLE_ONEWIRE_BACKEND
        prompt "1-Wire backend"
        default EXAMPLE_ONEWIRE_BACKEND_RMT
        help
            Select which backend is used by onewire_bus.

        config EXAMPLE_ONEWIRE_BACKEND_RMT
            bool "RMT backend"

        config EXAMPLE_ONEWIRE_BACKEND_UART
            bool "UART backend"
    endchoice

    config EXAMPLE_ONEWIRE_UART_PORT_NUM
        int "UART port number (for UART backend)"
        range 0 2
        default 1
        depends on EXAMPLE_ONEWIRE_BACKEND_UART
        help
            UART port index passed to onewire_new_bus_uart().

endmenu
```

## components/ds18b20/examples/ds18b20_sensor_hub/main/Kconfig.projbuild
```kconfig
menu "Example Configuration"

    config EXAMPLE_ONEWIRE_BUS_GPIO
        int "1-Wire bus GPIO number"
        range 0 48
        default 0
        help
            GPIO used by the 1-Wire bus.

    config EXAMPLE_ONEWIRE_ENABLE_INTERNAL_PULLUP
        bool "Enable internal pull-up resistor on bus GPIO"
        default y
        help
            Enable this when there is no external pull-up resistor on the
            1-Wire data line.

    config EXAMPLE_ONEWIRE_UART_PORT_NUM
        int "UART port number (for UART backend)"
        range 0 2
        default 1
        help
            UART port index passed to onewire_new_bus_uart().

    config EXAMPLE_MEASUREMENT_PERIOD
        int "Temperature measurement period"
        range 50 5000
        default 500
        help
            Delay between each temperature measurement

endmenu
```

## components/esp_jpeg/Kconfig
```kconfig
menu "JPEG Decoder"

    config JD_USE_ROM
        bool "Use TinyJPG Decoder from ROM"
        default y if IDF_TARGET_ESP32
        default y if IDF_TARGET_ESP32S3
        default y if IDF_TARGET_ESP32C2
        default y if IDF_TARGET_ESP32C3
        default y if IDF_TARGET_ESP32H2
        default n if IDF_TARGET_ESP32S2
        help
            Some microcontrollers have TJpg decoder in ROM. It is used as default, but it can be disabled here.
            Then there will be used code saved in this component. When this choice will be selected and MCU has not
            TJpg decoder in ROM code, there will be compilation error.

    config JD_SZBUF
        int "Size of stream input buffer"
        depends on !JD_USE_ROM
        default 512

    config JD_FORMAT
        int
        depends on !JD_USE_ROM
        default 0 if JD_FORMAT_RGB888
        default 1 if JD_FORMAT_RGB565

        choice
            prompt "Output pixel format"
            depends on !JD_USE_ROM
            default JD_FORMAT_RGB888
            help
                Output format of the TJpg decoder. The component can select the output format in runtime,
                but it depends on this choice.

        config JD_FORMAT_RGB888
            bool "RGB888 (24-bit/pix)"
        config JD_FORMAT_RGB565
            bool "RGB565 (16-bit/pix)"
        endchoice

    config JD_USE_SCALE
        bool "Switches output descaling feature"
        depends on !JD_USE_ROM
        default y
        help
            If this choice is enabled, then can be used scaling output image in runtime.

    config JD_TBLCLIP
        bool "Use table conversion for saturation arithmetic"
        depends on !JD_USE_ROM
        default y
        help
            Use table conversion for saturation arithmetic. A bit faster, but increases 1 KB of code size.

    config JD_FASTDECODE
        int
        depends on !JD_USE_ROM
        default 0 if JD_FASTDECODE_BASIC
        default 1 if JD_FASTDECODE_32BIT
        default 2 if JD_FASTDECODE_TABLE

        choice
            prompt "Optimization level"
            depends on !JD_USE_ROM
            default JD_FASTDECODE_BASIC

        config JD_FASTDECODE_BASIC
            bool "Basic optimization. Suitable for 8/16-bit MCUs"
        config JD_FASTDECODE_32BIT
            bool "+ 32-bit barrel shifter. Suitable for 32-bit MCUs"
        config JD_FASTDECODE_TABLE
            bool "+ Table conversion for huffman decoding (wants 6 << HUFF_BIT bytes of RAM)"
        endchoice
endmenu
```

## components/esp_lvgl_port/examples/mipi_dsi/main/Kconfig.projbuild
```kconfig
menu "Example Configuration"
    config EXAMPLE_AVOID_BLUE_SCREEN
        bool "Avoid blue screen caused for PSRAM bandwidth"
        default y
        help
            Enable this option, DMA2D peak will be limted, then GDMA will run normal.
endmenu
```

## components/esp_lvgl_port/examples/mipi_dsi/sdkconfig.defaults
```kconfig
#
# Serial flasher config
#
CONFIG_ESPTOOLPY_FLASHMODE_QIO=y
CONFIG_ESPTOOLPY_FLASHFREQ_80M=y
CONFIG_ESPTOOLPY_FLASHSIZE_16MB=y

#
# Compiler options
#
CONFIG_COMPILER_OPTIMIZATION_PERF=y

#
# Kernel
#
CONFIG_FREERTOS_HZ=1000

#
# LVGL configuration
#
CONFIG_LV_CONF_SKIP=y

#
# Enable built-in fonts
#
CONFIG_LV_FONT_MONTSERRAT_14=y
CONFIG_LV_FONT_MONTSERRAT_16=y
CONFIG_LV_FONT_MONTSERRAT_18=y
CONFIG_LV_FONT_MONTSERRAT_22=y
CONFIG_LV_FONT_MONTSERRAT_24=y
CONFIG_LV_FONT_MONTSERRAT_32=y

#
# Color Settings
#
CONFIG_LV_COLOR_DEPTH_24=y

#
# Compiler Settings
#
CONFIG_LV_ATTRIBUTE_FAST_MEM_USE_IRAM=y

#
# Logging
#
CONFIG_LV_USE_LOG=n
CONFIG_LV_LOG_LEVEL_ERROR=y
CONFIG_LV_LOG_PRINTF=n

#
# Display
#
CONFIG_BSP_LCD_DPI_BUFFER_NUMS=2
CONFIG_BSP_DISPLAY_LVGL_AVOID_TEAR=y
CONFIG_BSP_DISPLAY_LVGL_DIRECT_MODE=y
CONFIG_BSP_LCD_COLOR_FORMAT_RGB888=y
CONFIG_BSP_LCD_TYPE_1280_800=y
# end of Display
# end of Board Support Package(ESP32-P4)

#
# Partition Table
#
CONFIG_PARTITION_TABLE_CUSTOM=y
CONFIG_PARTITION_TABLE_CUSTOM_FILENAME="partitions.csv"
CONFIG_PARTITION_TABLE_FILENAME="partitions.csv"

#
# Demos
#
CONFIG_LV_USE_DEMO_WIDGETS=y
CONFIG_LV_DEMO_WIDGETS_SLIDESHOW=y
CONFIG_LV_USE_DEMO_KEYPAD_AND_ENCODER=y
CONFIG_LV_USE_DEMO_BENCHMARK=y
CONFIG_LV_USE_DEMO_RENDER=y
CONFIG_LV_USE_DEMO_SCROLL=y
CONFIG_LV_USE_DEMO_STRESS=y
CONFIG_LV_USE_DEMO_TRANSFORM=y
CONFIG_LV_USE_DEMO_MUSIC=y
CONFIG_LV_DEMO_MUSIC_SQUARE=y
CONFIG_LV_DEMO_MUSIC_LANDSCAPE=y
CONFIG_LV_DEMO_MUSIC_ROUND=y
CONFIG_LV_DEMO_MUSIC_LARGE=y
CONFIG_LV_DEMO_MUSIC_AUTO_PLAY=y
CONFIG_LV_USE_DEMO_FLEX_LAYOUT=y
CONFIG_LV_USE_DEMO_MULTILANG=n
# end of Demos
# end of LVGL configuration
# end of Component config

#
# Others
#
CONFIG_LV_USE_OBSERVER=y
CONFIG_LV_USE_SYSMON=y
CONFIG_LV_USE_PERF_MONITOR=y
```

## components/esp_lvgl_port/examples/mipi_dsi/sdkconfig.defaults.esp32p4
```kconfig
CONFIG_SPIRAM=y
CONFIG_SPIRAM_MODE_HEX=y
CONFIG_IDF_EXPERIMENTAL_FEATURES=y
CONFIG_SPIRAM_SPEED_200M=y
CONFIG_SPIRAM_MEMTEST=n
CONFIG_CACHE_L2_CACHE_LINE_128B=y

CONFIG_LV_COLOR_DEPTH_16=n
CONFIG_BSP_LCD_COLOR_FORMAT_RGB565=n

#
# ESP-MM: Memory Management Configurations
#
CONFIG_ESP_MM_CACHE_MSYNC_C2M_CHUNKED_OPS=y
CONFIG_ESP_MM_CACHE_MSYNC_C2M_CHUNKED_OPS_MAX_LEN=0x4000
# end of ESP-MM: Memory Management Configurations

#
# Example Configuration
#
CONFIG_EXAMPLE_AVOID_BLUE_SCREEN=y
# end of Example Configuration

#
# Rendering Configuration
#
# Set custom ASM render and provide a header file with function prototypes
CONFIG_LV_DRAW_SW_ASM_CUSTOM=y
CONFIG_LV_DRAW_SW_ASM_CUSTOM_INCLUDE="esp_lvgl_port_lv_blend_ppa.h"

#
# Memory Settings
#
CONFIG_LV_USE_CUSTOM_MALLOC=y
CONFIG_LV_USE_CLIB_SPRINTF=y
CONFIG_LV_USE_CLIB_STRING=y
```

## components/io_expander/esp_io_expander/Kconfig
```kconfig
menu "ESP IO Expander"

    config IO_EXPANDER_ENABLE_GPIO_API_WRAPPER
        bool "Enable GPIO API wrapper"
        default y
        help
            If enabled, ESP-IDF GPIO APIs can be used to control the IOs of IO expander. Full GPIO expander support links when you call esp_io_expander_gpio_wrapper_append_handler()

endmenu
```
