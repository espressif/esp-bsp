## bsp/esp32_s3_lcd_ev_board/Kconfig
```kconfig
menu "Board Support Package"

    config BSP_ERROR_CHECK
        bool "Enable error check in BSP"
        default y
        help
            Error check assert the application before returning the error code.

    menu "I2C"
        config BSP_I2C_NUM
            int "I2C peripheral index"
            default 1
            range 0 1
            help
                ESP32S3 has two I2C peripherals, pick the one you want to use.

        config BSP_I2C_FAST_MODE
            bool "Enable I2C fast mode"
            default y
            help
                I2C has two speed modes: normal (100kHz) and fast (400kHz).

        config BSP_I2C_CLK_SPEED_HZ
            int
            default 400000 if BSP_I2C_FAST_MODE
            default 100000
    endmenu

    menu "SPIFFS - Virtual File System"
        config BSP_SPIFFS_FORMAT_ON_MOUNT_FAIL
            bool "Format SPIFFS if mounting fails"
            default n
            help
                Format SPIFFS if it fails to mount the filesystem.

        config BSP_SPIFFS_MOUNT_POINT
            string "SPIFFS mount point"
            default "/spiffs"
            help
                Mount point of SPIFFS in the Virtual File System.

        config BSP_SPIFFS_PARTITION_LABEL
            string "Partition label of SPIFFS"
            default "storage"
            help
                Partition label which stores SPIFFS.

        config BSP_SPIFFS_MAX_FILES
            int "Max files supported for SPIFFS VFS"
            default 5
            help
                Supported max files for SPIFFS in the Virtual File System.
    endmenu

    menu "LCD"
        choice BSP_LCD_SUB_BOARD
            prompt "Select Target Sub board"
            default BSP_LCD_SUB_BOARD_NONE
            help
                Select the sub-board of the LCD. If there are no specific requirements for the sub board, please select "Not specifying a sub board".

            config BSP_LCD_SUB_BOARD_NONE
                bool "Not specifying a sub board"
            config BSP_LCD_SUB_BOARD_480_480
                bool "Sub board 2 with 480x480 RGB LCD"
            config BSP_LCD_SUB_BOARD_800_480
                bool "Sub board 3 with 800x480 RGB LCD"
        endchoice

        config BSP_LCD_SUB_BOARD_TYPE
            int
            default 0 if BSP_LCD_SUB_BOARD_NONE
            default 1 if BSP_LCD_SUB_BOARD_480_480
            default 2 if BSP_LCD_SUB_BOARD_800_480

        config BSP_LCD_RGB_BUFFER_NUMS
            int "Set number of frame buffers"
            default 1
            range 1 3
            help
                Let RGB LCD driver create a specified number of frame-size buffers. Only when it is set to multiple can the avoiding tearing be turned on.

        choice BSP_LCD_RGB_REFRESH_MODE
            prompt "Select the refresh mode for RGB LCD"
            default BSP_LCD_RGB_REFRESH_AUTO
            config BSP_LCD_RGB_REFRESH_AUTO
                bool "Auto refresh mode"
                help
                    Refresh the LCD in the most common way.
            config BSP_LCD_RGB_BOUNCE_BUFFER_MODE
                bool "Bounce buffer mode"
                help
                    Enable bounce buffer mode can achieve higher PCLK frequency at the cost of higher CPU consumption.
        endchoice

        config BSP_LCD_RGB_BOUNCE_BUFFER_HEIGHT
            depends on BSP_LCD_RGB_BOUNCE_BUFFER_MODE
            int "Bounce buffer height"
            default 10
            help
                Height of bounce buffer. The width of the buffer is the same as that of the LCD.
    endmenu

    menu "Display"
        config BSP_DISPLAY_LVGL_AVOID_TEAR
            bool "Avoid tearing effect"
            depends on BSP_LCD_RGB_BUFFER_NUMS > 1
            default "n"
            help
                Avoid tearing effect through LVGL buffer mode and double frame buffers of RGB LCD. This feature is only available for RGB LCD.

        choice BSP_DISPLAY_LVGL_MODE
            depends on BSP_DISPLAY_LVGL_AVOID_TEAR
            prompt "Select LVGL buffer mode"
            default BSP_DISPLAY_LVGL_FULL_REFRESH
            config BSP_DISPLAY_LVGL_FULL_REFRESH
                bool "Full refresh"
            config BSP_DISPLAY_LVGL_DIRECT_MODE
                bool "Direct mode"
        endchoice

        choice BSP_DISPLAY_LVGL_BUF_CAPS
            depends on !BSP_DISPLAY_LVGL_AVOID_TEAR
            prompt "Select LVGL buffer memory capability"
            default BSP_DISPLAY_LVGL_INTERNAL
            config BSP_DISPLAY_LVGL_PSRAM
                bool "PSRAM memory"
            config BSP_DISPLAY_LVGL_INTERNAL
                bool "Internal memory"
        endchoice

        config BSP_DISPLAY_LVGL_BUF_HEIGHT
            depends on !BSP_DISPLAY_LVGL_AVOID_TEAR
            int "LVGL buffer height"
            default 100
            help
                Height of LVGL buffer. The width of the buffer is the same as that of the LCD.
    endmenu

    config BSP_I2S_NUM
        int "I2S peripheral index"
        default 1
        range 0 1
        help
            ESP32S3 has two I2S peripherals, pick the one you want to use.
endmenu
```
