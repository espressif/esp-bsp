## SquareLine/boards/custom_waveshare_7inch/components/ws_7inch/Kconfig
```kconfig
menu "Board Support Package"
    menu "Display"
        config BSP_DISPLAY_LVGL_TASK_PRIORITY
            int "LVGL task priority"
            default 2
            help
                The Board Support Package will create a task that will periodically handle LVGL operation in lv_timer_handler().

        config BSP_DISPLAY_LVGL_TICK
        int "LVGL tick period"
        default 5
        range 1 100
        help
            Period of LVGL tick timer.

    endmenu
endmenu
```

## SquareLine/boards/v8/esp32_c3_lcdkit/sdkconfig.defaults
```kconfig
CONFIG_IDF_TARGET="esp32c3"
CONFIG_LV_COLOR_16_SWAP=y
CONFIG_LV_MEM_CUSTOM=y
CONFIG_LV_MEMCPY_MEMSET_STD=y
CONFIG_LV_USE_PERF_MONITOR=y
```

## bsp/esp32_azure_iot_kit/Kconfig
```kconfig
menu "Board Support Package"

    config BSP_ERROR_CHECK
        bool "Enable error check in BSP"
        default y
        help
            Error check assert the application before returning the error code.
            
    menu "I2C"
        config BSP_I2C_NUM
            int "I2C peripheral index"
            default 1
            range 0 1
            help
                ESP32 has two I2C peripherals, pick the one you want to use.

        config BSP_I2C_FAST_MODE
            bool "Enable I2C fast mode"
            default n
            help
                I2C has two speed modes: normal (100kHz) and fast (400kHz).

        config BSP_I2C_CLK_SPEED_HZ
            int
            default 400000 if BSP_I2C_FAST_MODE
            default 100000

    endmenu

    menu "SPIFFS - Virtual File System"
        config BSP_SPIFFS_FORMAT_ON_MOUNT_FAIL
            bool "Format SPIFFS if mounting fails"
            default n
            help
                Format SPIFFS if it fails to mount the filesystem.

        config BSP_SPIFFS_MOUNT_POINT
            string "SPIFFS mount point"
            default "/spiffs"
            help
                Mount point of SPIFFS in the Virtual File System.

        config BSP_SPIFFS_PARTITION_LABEL
            string "Partition label of SPIFFS"
            default "storage"
            help
                Partition label which stores SPIFFS.

        config BSP_SPIFFS_MAX_FILES
            int "Max files supported for SPIFFS VFS"
            default 5
            help
                Supported max files for SPIFFS in the Virtual File System.
    endmenu

    menu "uSD card - Virtual File System"
        config BSP_SD_FORMAT_ON_MOUNT_FAIL
            bool "Format uSD card if mounting fails"
            default n
            help
                The SDMMC host will format (FAT) the uSD card if it fails to mount the filesystem.

        config BSP_SD_MOUNT_POINT
            string "uSD card mount point"
            default "/sdcard"
            help
                Mount point of the uSD card in the Virtual File System

    endmenu

    menu "Buzzer"
        config BSP_BUZZER_FREQUENCY
            int "Buzzer frequency [Hz]"
            default 4000
            range 1000 8000
            help
                Resonant requency of onboard buzzer is 4kHz.

        config BSP_BUZZER_LEDC_TIMER_NUM
            int "LEDC timer number for buzzer"
            default 0
            range 0 3
            help
                LEDC peripheral has 4 timers, pick one.

        config BSP_BUZZER_LEDC_CHANNEL_NUM
            int "LEDC channel number for buzzer"
            default 0
            range 0 7
            help
                LEDC peripheral has 7 high-speed channels, pick one.

    endmenu
endmenu
```

## bsp/esp32_c3_lcdkit/Kconfig
```kconfig
menu "Board Support Package (ESP32-C3-LCDKit)"

    config BSP_ERROR_CHECK
        bool "Enable error check in BSP"
        default y
        help
            Error check assert the application before returning the error code.
    menu "SPIFFS - Virtual File System"
        config BSP_SPIFFS_FORMAT_ON_MOUNT_FAIL
            bool "Format SPIFFS if mounting fails"
            default n
            help
                Format SPIFFS if it fails to mount the filesystem.

        config BSP_SPIFFS_MOUNT_POINT
            string "SPIFFS mount point"
            default "/spiffs"
            help
                Mount point of SPIFFS in the Virtual File System.

        config BSP_SPIFFS_PARTITION_LABEL
            string "Partition label of SPIFFS"
            default "storage"
            help
                Partition label which stores SPIFFS.

        config BSP_SPIFFS_MAX_FILES
            int "Max files supported for SPIFFS VFS"
            default 5
            help
                Supported max files for SPIFFS in the Virtual File System.
    endmenu
    menu "Display"
        config BSP_DISPLAY_BRIGHTNESS_LEDC_CH
        int "LEDC channel index"
        default 1
        range 0 7
        help
            LEDC channel is used to generate PWM signal that controls display brightness.
            Set LEDC index that should be used.
                
        config BSP_LCD_DRAW_BUF_HEIGHT
        int "LCD framebuf height"
        default 100
        range 10 240
        help
            Framebuf is used for lvgl rendering output.

        config BSP_LCD_DRAW_BUF_DOUBLE
        bool "LCD double framebuf"
        default y
        help
            Whether to enable double framebuf.
    endmenu
    menu "LEDs"
        choice BSP_LED_RGB_BACKEND
            prompt "Adressable RGB LED backend peripheral"
            default BSP_LED_RGB_BACKEND_RMT
            default BSP_LED_RGB_BACKEND_SPI
            help
                Select the backend peripheral to drive the LED strip.

            config BSP_LED_RGB_BACKEND_RMT
                bool "RMT"
            if BSP_ESP_IDF_VERSION>="5.0"
                config BSP_LED_RGB_BACKEND_SPI
                    bool "SPI"
            endif
        endchoice
    endmenu
    config BSP_I2S_NUM
        int "I2S peripheral index"
        default 0
        range 0 0
        help
            Pick the I2S you want to use.
endmenu
```

## bsp/esp32_p4_function_ev_board/examples/wifi_connection/sdkconfig.defaults
```kconfig
CONFIG_IDF_TARGET="esp32p4"
CONFIG_EXAMPLE_CONNECT_WIFI=y
CONFIG_SLAVE_IDF_TARGET_ESP32C6=y
CONFIG_ESP_SDIO_BUS_WIDTH=4
CONFIG_ESP_SDIO_CLOCK_FREQ_KHZ=40000
CONFIG_ESP_SDIO_PIN_CMD=19
CONFIG_ESP_SDIO_PIN_CLK=18
CONFIG_ESP_SDIO_PIN_D0=14
CONFIG_ESP_SDIO_PIN_D1=15
CONFIG_ESP_SDIO_PIN_D2=16
CONFIG_ESP_SDIO_PIN_D3=17
```

## bsp/esp32_s31_korvo_1/Kconfig
```kconfig
menu "Board Support Package (ESP32-S31-Korvo-1)"

    config BSP_ERROR_CHECK
        bool "Enable error check in BSP"
        default y
        help
            Error check assert the application before returning the error code.
    menu "I2C"
        config BSP_I2C_NUM
            int "I2C peripheral index"
            default 1
            range 0 2
            help
                Pick the I2C you want to use.
    endmenu
    menu "Storage"
        menu "SPIFFS - Virtual File System"
            config BSP_SPIFFS_FORMAT_ON_MOUNT_FAIL
                bool "Format SPIFFS if mounting fails"
                default n
                help
                    Format SPIFFS if it fails to mount the filesystem.

            config BSP_SPIFFS_MOUNT_POINT
                string "SPIFFS mount point"
                default "/spiffs"
                help
                    Mount point of SPIFFS in the Virtual File System.

            config BSP_SPIFFS_PARTITION_LABEL
                string "Partition label of SPIFFS"
                default "storage"
                help
                    Partition label which stores SPIFFS.

            config BSP_SPIFFS_MAX_FILES
                int "Max files supported for SPIFFS VFS"
                default 5
                help
                    Supported max files for SPIFFS in the Virtual File System.
        endmenu
        menu "SD card - Virtual File System"
            config BSP_SD_FORMAT_ON_MOUNT_FAIL
                bool "Format SD card if mounting fails"
                default n
                help
                    The SDMMC host will format (FAT) the SD card if it fails to mount the filesystem.

            config BSP_SD_MOUNT_POINT
                string "SD card mount point"
                default "/sdcard"
                help
                    Mount point of the SD card in the Virtual File System

        endmenu
    endmenu
    menu "Display"

        config BSP_LCD_DRAW_BUF_HEIGHT
        int "LCD framebuf height"
        default 100
        range 10 240
        help
            Framebuf is used for lvgl rendering output.

        config BSP_LCD_DRAW_BUF_DOUBLE
        bool "LCD double framebuf"
        default y
        help
            Whether to enable double framebuf.
        config BSP_LCD_RGB_BUFFER_NUMS
            int "Set number of frame buffers"
            default 1
            range 1 3
            help
                Let RGB LCD driver create a specified number of frame-size buffers. Only when it is set to multiple can the avoiding tearing be turned on.

        config BSP_DISPLAY_LVGL_AVOID_TEAR
            bool "Avoid tearing effect"
            depends on BSP_LCD_RGB_BUFFER_NUMS > 1
            default "n"
            help
                Avoid tearing effect through LVGL buffer mode and double frame buffers of LCD.

        choice BSP_DISPLAY_LVGL_MODE
            depends on BSP_DISPLAY_LVGL_AVOID_TEAR
            prompt "Select LVGL buffer mode"
            default BSP_DISPLAY_LVGL_FULL_REFRESH
            config BSP_DISPLAY_LVGL_FULL_REFRESH
                bool "Full refresh"
            config BSP_DISPLAY_LVGL_DIRECT_MODE
                bool "Direct mode"
        endchoice

        choice BSP_LCD_RGB_REFRESH_MODE
            prompt "Select the refresh mode for RGB LCD"
            default BSP_LCD_RGB_REFRESH_AUTO
            config BSP_LCD_RGB_REFRESH_AUTO
                bool "Auto refresh mode"
                help
                    Refresh the LCD in the most common way.
            config BSP_LCD_RGB_BOUNCE_BUFFER_MODE
                bool "Bounce buffer mode"
                help
                    Enable bounce buffer mode can achieve higher PCLK frequency at the cost of higher CPU consumption.
        endchoice

        config BSP_LCD_RGB_BOUNCE_BUFFER_HEIGHT
            depends on BSP_LCD_RGB_BOUNCE_BUFFER_MODE
            int "Bounce buffer height"
            default 10
            help
                Height of bounce buffer. The width of the buffer is the same as that of the LCD.
    endmenu
    menu "Camera"
        config BSP_CAMERA_XCLK_LEDC_CH
        int "LEDC channel index"
        default 2
        range 0 7
        help
            LEDC channel is used to generate PWM signal that controls camera clock.
            Set LEDC index that should be used.
    endmenu
    menu "LEDs"
        choice BSP_LED_RGB_BACKEND
            prompt "Adressable RGB LED backend peripheral"
            default BSP_LED_RGB_BACKEND_RMT
            help
                Select the backend peripheral to drive the LED strip.

            config BSP_LED_RGB_BACKEND_RMT
                bool "RMT"
            if BSP_ESP_IDF_VERSION>="5.0"
                config BSP_LED_RGB_BACKEND_SPI
                    bool "SPI"
            endif
        endchoice
    endmenu
    menu "Audio"
        config BSP_I2S_NUM
            int "I2S peripheral index"
            default 1
            range 0 2
            help
                Pick the I2S you want to use.
    endmenu
endmenu
```
